## main/Kconfig.projbuild
```kconfig
menu "Example Configuration"
    config EXAMPLE_USED_LDO_CHAN_ID
        int "example used LDO channel ID"
        default 3
        help
            Example used LDO channel ID, you may check datasheet to know more details.

    config EXAMPLE_USED_LDO_VOLTAGE_MV
        int "example used LDO voltage in mV"
        default 2500
        range 0 3300
        help
            Example used LDO voltage, in mV

    config EXAMPLE_CAM_PORT_ISP_MIPI
        bool
        default y

    choice EXAMPLE_MIPI_CSI_DISP_HRES
        bool "Set MIPI CSI horizontal resolution"
        default EXAMPLE_MIPI_CSI_HRES_1920

        config EXAMPLE_MIPI_CSI_HRES_800
            bool "800"
        config EXAMPLE_MIPI_CSI_HRES_1024
            bool "1024"
        config EXAMPLE_MIPI_CSI_HRES_1280
            bool "1280 (960p binning, OV5647 RAW10, low-noise)"
        config EXAMPLE_MIPI_CSI_HRES_1920
            bool "1920 (1080p, OV5647 RAW10)"
    endchoice

    config EXAMPLE_MIPI_CSI_DISP_HRES
        int
        default 800 if EXAMPLE_MIPI_CSI_HRES_800
        default 1024 if EXAMPLE_MIPI_CSI_HRES_1024
        default 1280 if EXAMPLE_MIPI_CSI_HRES_1280
        default 1920 if EXAMPLE_MIPI_CSI_HRES_1920

    choice EXAMPLE_MIPI_CSI_DISP_VRES
        bool "Set MIPI CSI vertical resolution"
        default EXAMPLE_MIPI_CSI_VRES_1080

        config EXAMPLE_MIPI_CSI_VRES_600
            bool "600"
        config EXAMPLE_MIPI_CSI_VRES_640
            bool "640"
        config EXAMPLE_MIPI_CSI_VRES_800
            bool "800"
        config EXAMPLE_MIPI_CSI_VRES_960
            bool "960 (binning, low-noise)"
        config EXAMPLE_MIPI_CSI_VRES_1080
            bool "1080 (1080p, OV5647 RAW10)"
        config EXAMPLE_MIPI_CSI_VRES_1280
            bool "1280"
    endchoice

    config EXAMPLE_MIPI_CSI_DISP_VRES
        int
        default 600 if EXAMPLE_MIPI_CSI_VRES_600
        default 640 if EXAMPLE_MIPI_CSI_VRES_640
        default 800 if EXAMPLE_MIPI_CSI_VRES_800
        default 960 if EXAMPLE_MIPI_CSI_VRES_960
        default 1080 if EXAMPLE_MIPI_CSI_VRES_1080
        default 1280 if EXAMPLE_MIPI_CSI_VRES_1280

    config EXAMPLE_JPEG_QUALITY
        int "JPEG encode quality (1-100)"
        default 85
        range 1 100
        help
            Hardware JPEG encoder quality factor. Higher = better image but
            larger frames / more bandwidth. 85 is a good balance for a
            1280x960 MJPEG stream over 100 Mbps Ethernet.

    config EXAMPLE_ISP_TUNING_ENABLE
        bool "Enable ISP image-quality tuning (denoise / gamma / CCM / sharpen)"
        default y
        help
            Turn on the optional ISP processing blocks (Bayer denoise, demosaic
            gradient, gamma, color-correction matrix, light sharpening) for a
            cleaner, more natural picture. Disable to compare against the raw
            demosaic-only output. Black-level correction (BLC) is not included
            because it needs ESP32-P4 chip rev >= v3.0.

    config EXAMPLE_UDP_DEST_IP
        string "Destination IP for the UDP video stream (your PC running the viewer)"
        default "192.168.1.100"
        help
            IPv4 address the firmware sends the MJPEG stream to. Set this to the
            IP of the PC running tools/viewer_win.py (or recorder_nas.py). The
            real value lives in your local sdkconfig (gitignored), so it is not
            published. Change it with `idf.py menuconfig`.

    config EXAMPLE_UDP_DEST_PORT
        int "Destination UDP port"
        default 12345
        range 1 65535
        help
            UDP port the viewer/recorder listens on.
endmenu
```

## sdkconfig.defaults
```kconfig
CONFIG_CAMERA_SC2336=y
CONFIG_CAMERA_OV5647=y
CONFIG_CAM_CTRL_SPI_ENABLE=n

# Stream resolution: 1080p30 (OV5647 RAW10 -> ISP RGB565 -> hardware JPEG)
CONFIG_EXAMPLE_MIPI_CSI_HRES_1280=y
CONFIG_EXAMPLE_MIPI_CSI_VRES_960=y
CONFIG_EXAMPLE_JPEG_QUALITY=80
```
